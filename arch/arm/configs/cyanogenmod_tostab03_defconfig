## arch/arm/mach-tegra/nv/Kconfig
```kconfig
comment "NVIDIA NVRM/NVOS options"


config TEGRA_NVRM
	bool "Enable NVRM stub driver"
	default n
	help
		Enable NVRM stub driver


config TEGRA_NVOS
	bool "Enable NVOS driver"
	default n
	help
		Enable NVOS driver

config TEGRA_ODM_DMIEEP
    boolean "DMI EEPROM for NVIDIA Tegra ODM kit"
    help
        Say Y here if you want to enable a dmieep input device node
        using the NVIDIA Tegra ODM kit dmieep adaptation interface
```

## drivers/input/switch/Kconfig
```kconfig
#
# Input core configuration
#
menuconfig INPUT_SWITCH
	bool "Switch" if EMBEDDED || !X86
	default y
	help
	  Say Y here, and a list of supported switch will be displayed.
	  This option doesn't affect the kernel.

	  If unsure, say Y.

if INPUT_SWITCH

config INPUT_GPIO_SWITCH
	tristate "GPIO Switch"
	depends on GENERIC_GPIO
	help
	  This driver implements support for switch connected
	  to GPIO pins of various CPUs (and some other chips).

	  Say Y here if your device has switch connected
	  directly to such GPIO pins.  Your board-specific
	  setup logic must also provide a platform device,
	  with configuration data saying which GPIOs are used.

	  To compile this driver as a module, choose M here: the
	  module will be called gpio_switch.

endif
```

## sound/soc/aec/Kconfig
```kconfig
config SND_SOC_FM34
	boolean "Fortemedia I2C based echo cancellation driver" 
	depends on I2C
	help
		This enables support for Fortemedia over I2C based echo cancellation.
```
